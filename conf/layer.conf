## conf/layer.conf
```bitbake
# Copyright (C) 2014 Oliver Stäbler <oliver.staebler@bytesatwork.ch>
# Released under the MIT license (see COPYING.MIT for the terms)

# We have a conf and classes directory, add to BBPATH
BBPATH =. "${LAYERDIR}:"

# We have recipes-* directories, add to BBFILES
BBFILES += "${LAYERDIR}/recipes-*/*/*.bb \
            ${LAYERDIR}/recipes-*/*/*.bbappend"

BBFILE_COLLECTIONS += "meta-bytesatwork"
BBFILE_PATTERN_meta-bytesatwork = "^${LAYERDIR}/"
BBFILE_PRIORITY_meta-bytesatwork = "7"

LAYERDEPENDS_meta-bytesatwork = " \
	openembedded-layer \
	networking-layer \
	meta-python \
"

LAYERSERIES_COMPAT_meta-bytesatwork = "sumo"

IMAGE_CLASSES += "sdcard_image-bytesatwork"
```

## conf/machine/byteboard.conf
```bitbake
# Copyright (C) 2016 Daniel Ammann <daniel.ammann@bytesatwork.ch>
# Released under the MIT license (see COPYING.MIT for the terms)

#@TYPE: Machine
#@NAME: byteBOARD
#@DESCRIPTION: byteBOARD by bytes at work AG

require conf/machine/include/ti43x.inc
require include/byteengine.inc

UBOOT_MACHINE = "byteengine_m3_config"

KERNEL_DEVICETREE_byteboard = "byteboard.dtb"
```

## conf/machine/bytepanel-emmc.conf
```bitbake
# Copyright (C) 2014-2017 Oliver Stäbler <oliver.staebler@bytesatwork.ch>
# Released under the MIT license (see COPYING.MIT for the terms)

#@TYPE: Machine
#@NAME: bytePANEL eMMC
#@DESCRIPTION: bytePANEL eMMC by bytes at work AG

require conf/machine/include/ti33x.inc
require include/byteengine.inc

UBOOT_MACHINE = "byteengine_m2_rev4_config"

KERNEL_DEVICETREE_bytepanel-emmc = "bytepanel-emmc.dtb"
KERNEL_DEFCONFIG = "bytepanel_defconfig"

MACHINE_FEATURES += "touchscreen"
```

## conf/machine/bytepanel.conf
```bitbake
# Copyright (C) 2014-2016 Oliver Stäbler <oliver.staebler@bytesatwork.ch>
# Released under the MIT license (see COPYING.MIT for the terms)

#@TYPE: Machine
#@NAME: bytePANEL
#@DESCRIPTION: bytePANEL by bytes at work AG

require conf/machine/include/ti33x.inc
require include/byteengine.inc

UBOOT_MACHINE = "am335x_m2_config"

KERNEL_DEVICETREE_bytepanel = "bytepanel.dtb bytepanel-et070080dh6.dtb"

MACHINE_FEATURES += "touchscreen"

IMAGE_FSTYPES += "jffs2.sum"
JFFS2_ERASEBLOCK = "0x20000"
EXTRA_IMAGECMD_jffs2 = "--eraseblock=${JFFS2_ERASEBLOCK} --no-cleanmarkers --little-endian"
JFFS2_SUM_EXTRA_ARGS = "--eraseblock=${JFFS2_ERASEBLOCK} --cleanmarker 16 --littleendian --pad"
```

## conf/machine/include/byteengine.inc
```bitbake
# Copyright (C) 2014-2016 Oliver Stäbler <oliver.staebler@bytesatwork.ch>
# Released under the MIT license (see COPYING.MIT for the terms)

#@TYPE: Machine
#@NAME: byteENGINE
#@DESCRIPTION: byteENGINE by bytes at work AG

SERIAL_CONSOLES = "115200;ttyO0"
IMAGE_FSTYPES = "tar.bz2 bytesatwork-sdimg"

KERNEL_IMAGETYPE = "uImage"
PREFERRED_PROVIDER_virtual/kernel = "linux-ti-staging"
PREFERRED_PROVIDER_virtual/bootloader = "u-boot-ti-staging"
PREFERRED_VERSION_linux-ti-staging = "4.4%"
PREFERRED_VERSION_u-boot-ti-staging = "2015.07%"
```
